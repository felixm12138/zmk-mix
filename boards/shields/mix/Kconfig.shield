## boards/shields/mix/Kconfig.shield
```kconfig
# No whitespace after the comma or in your keyboard name!
config SHIELD_MIX_LEFT
    def_bool $(shields_list_contains,mix_left)

config SHIELD_MIX_RIGHT
    def_bool $(shields_list_contains,mix_right)
```
