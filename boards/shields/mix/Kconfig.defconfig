## boards/shields/mix/Kconfig.defconfig
```kconfig
if SHIELD_MIX_RIGHT

config ZMK_KEYBOARD_NAME
    default "mix"

config ZMK_SPLIT_ROLE_CENTRAL
    default y

config ZMK_POINTING
    default y

endif

if SHIELD_MIX_LEFT || SHIELD_MIX_RIGHT


config SPI
    default y

config ZMK_SPLIT
    default y

endif
```

## config/west.yml
```yaml
manifest:
  remotes:
  - name: zmkfirmware
    url-base: https://github.com/zmkfirmware

  projects:
  - name: zmk
    remote: zmkfirmware
    revision: v0.3
    import: app/west.yml
  - name: cirque-input-module
    url: https://github.com/geeksville/cirque-input-module
    revision: main
    path: modules/cirque-input-module
  self:
    path: config
```
